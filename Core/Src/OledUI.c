/*
 * OledUI.c
 *
 *  Created on: Jun 15, 2026
 *      Author: Pika
 */

#include "OledUI.h"
#include "ssd1306_fonts.h"
#include <stdbool.h>
#include <stdio.h>

extern int8_t levelWater;

const char *s_brewStepName[6] = {
    "   POSITIONING   ",
    "  CUTTING PACKET ",
    "DISPENSING COFFEE",
    "  ADDING WATER   ",
    "     MIXING      ",
    "    FINISHING    "
};

// 'cafe', 42x41px
const unsigned char icon_cafe_full_42x41 [] = {
	0x00, 0x21, 0x8c, 0x00, 0x00, 0x00, 0x00, 0x73, 0x9c, 0x00, 0x00, 0x00, 0x00, 0x63, 0x1c, 0x00,
	0x00, 0x00, 0x00, 0xe3, 0x18, 0x00, 0x00, 0x00, 0x00, 0x63, 0x9c, 0x00, 0x00, 0x00, 0x00, 0x73,
	0x8c, 0x00, 0x00, 0x00, 0x00, 0x31, 0xce, 0x00, 0x00, 0x00, 0x00, 0x30, 0xc6, 0x00, 0x00, 0x00,
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	0x00, 0x00, 0x00, 0x00, 0x00, 0x00
};

// 'cafe_mid', 42x41px
const unsigned char icon_cafe_mid_42x41 []  = {
	0x00, 0x21, 0x8c, 0x00, 0x00, 0x00, 0x00, 0x73, 0x9c, 0x00, 0x00, 0x00, 0x00, 0x63, 0x1c, 0x00,
	0x00, 0x00, 0x00, 0xe3, 0x18, 0x00, 0x00, 0x00, 0x00, 0x63, 0x9c, 0x00, 0x00, 0x00, 0x00, 0x73,
	0x8c, 0x00, 0x00, 0x00, 0x00, 0x31, 0xce, 0x00, 0x00, 0x00, 0x00, 0x30, 0xc6, 0x00, 0x00, 0x00,
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	0x00, 0x00, 0x00, 0x00, 0x00, 0x00
};
// 'cafe_low_', 42x41px
const unsigned char icon_cafe_low_42x41 []  = {
	0x00, 0x21, 0x8c, 0x00, 0x00, 0x00, 0x00, 0x73, 0x9c, 0x00, 0x00, 0x00, 0x00, 0x63, 0x1c, 0x00,
	0x00, 0x00, 0x00, 0xe3, 0x18, 0x00, 0x00, 0x00, 0x00, 0x63, 0x9c, 0x00, 0x00, 0x00, 0x00, 0x73,
	0x8c, 0x00, 0x00, 0x00, 0x00, 0x31, 0xce, 0x00, 0x00, 0x00, 0x00, 0x30, 0xc6, 0x00, 0x00, 0x00,
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	0x00, 0x00, 0x00, 0x00, 0x00, 0x00
};

// 'warning', 31x28px
const unsigned char icon_warning_31x28 [] = {
	0x00, 0x00, 0x00, 0x00, 0x00, 0x01, 0x00, 0x00, 0x00, 0x03, 0x80, 0x00, 0x00, 0x07, 0xc0, 0x00,
	0x00, 0x0e, 0xe0, 0x00, 0x00, 0x0c, 0x60, 0x00, 0x00, 0x1c, 0x70, 0x00, 0x00, 0x18, 0x30, 0x00,
	0x00, 0x38, 0x38, 0x00, 0x00, 0x73, 0x98, 0x00, 0x00, 0x63, 0x8c, 0x00, 0x00, 0xe3, 0x8e, 0x00,
	0x00, 0xc3, 0x86, 0x00, 0x01, 0xc3, 0x87, 0x00, 0x03, 0x83, 0x83, 0x00, 0x03, 0x03, 0x83, 0x80,
	0x07, 0x03, 0x81, 0x80, 0x06, 0x03, 0x00, 0xc0, 0x0e, 0x00, 0x00, 0xe0, 0x0c, 0x00, 0x00, 0x60,
	0x1c, 0x03, 0x00, 0x70, 0x18, 0x03, 0x80, 0x30, 0x30, 0x01, 0x00, 0x38, 0x70, 0x00, 0x00, 0x1c,
	0x7f, 0xff, 0xff, 0xfc, 0x3f, 0xff, 0xff, 0xf8, 0x1f, 0xff, 0xff, 0xf0, 0x00, 0x00, 0x00, 0x00
};



void Ui_RenderBoot()
{
	ssd1306_Fill(Black);
	ssd1306_DrawBitmap(43,0,icon_cafe_full_42x41,42,41,White);
	ssd1306_SetCursor(3, 42);
	ssd1306_WriteString("Caffe Maker", Font_11x18, White);
	ssd1306_UpdateScreen();
}

// Hàm hiển thị màn hình chính, nhấn up/down để chọn mức nước, nhấn * trả về 1, nhấn # trả về 2
int HomeScreen()
{
	ssd1306_Fill(Black);
	ssd1306_DrawBitmap(0,0,icon_cafe_mid_42x41,42,41,White);
	ssd1306_SetCursor(85, 0);
	ssd1306_WriteChar('^', Font_7x10, White);
	ssd1306_SetCursor(85, 32);
	ssd1306_WriteChar('v', Font_7x10, White);
	ssd1306_SetCursor(52, 11);
	ssd1306_WriteString("Medium", Font_11x18, White);
	ssd1306_SetCursor(0, 54);
	ssd1306_WriteString("* Brew / # Setting", Font_7x10, White);
	ssd1306_UpdateScreen();
	HAL_Delay(1000);
	while(1)
	{
		bool isUpdateLevelWate = false;
		if(BTN_UP_PRESS){
			levelWater++;
			if(levelWater>=3) levelWater = 0;
			isUpdateLevelWate = true;
		}
		if(BTN_DOWN_PRESS){
			levelWater--;
			if(levelWater <0) levelWater =2;
			isUpdateLevelWate = true;
		}

		if(BTN_ENTER_PRESS) return 1;
		if(BTN_BACK_PRESS) return 2;

		if(isUpdateLevelWate)
		{
			switch(levelWater)
			{
			case 0:
				ssd1306_FillRectangle(0, 0, 42, 41, Black);
				ssd1306_DrawBitmap(0,0,icon_cafe_low_42x41,42,41,White);
				ssd1306_SetCursor(52, 11);
				ssd1306_WriteString(" Small", Font_11x18, White);
				break;
			case 1:
				ssd1306_FillRectangle(0, 0, 42, 41, Black);
				ssd1306_DrawBitmap(0,0,icon_cafe_mid_42x41,42,41,White);
				ssd1306_SetCursor(52, 11);
				ssd1306_WriteString("Medium", Font_11x18, White);
				break;
			case 2:
				ssd1306_FillRectangle(0, 0, 42, 41, Black);
				ssd1306_DrawBitmap(0,0,icon_cafe_full_42x41,42,41,White);
				ssd1306_SetCursor(52, 11);
				ssd1306_WriteString(" Large", Font_11x18, White);
				break;
			}
			ssd1306_UpdateScreen();
			HAL_Delay(100);
		}
	}
}



// Hàm hiển thị các bước pha chế và tiến trình hoàn thành
void UI_Brewing(uint8_t step)
{
    ssd1306_Fill(Black);
    ssd1306_SetCursor(25, 0);
    ssd1306_WriteString("BREWING", Font_11x18, White);
    ssd1306_SetCursor(4, 27);
    ssd1306_WriteString((char*)s_brewStepName[step], Font_7x10, White);


    ssd1306_FillRectangle(0, 49, 128, 64, White);	// vẽ nền Progress
    if(step <5){
    	// độ dài pixel tiến trình  là 128-4=124, được chia ra thành 5 phần=> mỗi phần 25
    	uint8_t x = 2+step*25;
    	ssd1306_FillRectangle(x, 51, 126, 61, Black);   	// vẽ tiến trình thực tế
    }
    ssd1306_UpdateScreen();
}

void BrewCompleteScreen()
{
	ssd1306_Fill(Black);
	ssd1306_DrawBitmap(43,0,icon_cafe_full_42x41,42,41,White);
	ssd1306_SetCursor(1, 50);
	ssd1306_WriteString("ENJOY YOUR COFFEE", Font_7x10, White);
	ssd1306_UpdateScreen();
	while(SENSOR_CUP_IS_OK)
	{
		HAL_Delay(100);
	}
}

void PacketEditorScreen()
{
    char line[10];
    bool isUpdate = true;
    ssd1306_Fill(Black);
    ssd1306_SetCursor(25, 0);
    ssd1306_WriteString("PACKETS", Font_11x18, White);

    ssd1306_SetCursor(0, 20);
    ssd1306_WriteChar('<', Font_11x18, White);
    ssd1306_SetCursor(116, 20);
    ssd1306_WriteChar('>', Font_11x18, White);
    ssd1306_SetCursor(53, 20);
    snprintf(line, sizeof(line), "%u", (unsigned int)countPacket);
    ssd1306_WriteString(line, Font_11x18, White);

    ssd1306_SetCursor(0, 53);
    ssd1306_WriteString("* Enter / # back", Font_7x10, White);
    ssd1306_UpdateScreen();
    HAL_Delay(500);
	while(1)
	{
		if(BTN_UP_PRESS){
			countPacket++;
			if(countPacket > PACKET_MAX) countPacket = 1;
			isUpdate = true;
		}
		if(BTN_DOWN_PRESS){
			countPacket--;
			if(countPacket <=1) countPacket =PACKET_MAX;
			isUpdate = true;
		}

		if(BTN_ENTER_PRESS) return;
		if(BTN_BACK_PRESS) return;

		if(isUpdate)
		{
			isUpdate = false;
			ssd1306_SetCursor(53, 20);
			if(countPacket >=10){
				snprintf(line, sizeof(line), "%u ", (unsigned int)countPacket);
			}else{
				snprintf(line, sizeof(line), " %u", (unsigned int)countPacket);
			}
			ssd1306_WriteString(line, Font_11x18, White);
			ssd1306_UpdateScreen();
			HAL_Delay(100);
		}
	}
}

void WarningScreen(WarningState_t warning)
{
	ssd1306_Fill(Black);
	ssd1306_DrawBitmap(48, 0, icon_warning_31x28, 31, 28, White);
	ssd1306_SetCursor(14, 30);

	if(warning == LOW_WATER){
		ssd1306_WriteString("LOW WATER", Font_11x18, White);
		ssd1306_SetCursor(4, 50);
		ssd1306_WriteString(" REFILL WATER TANK ", Font_6x8, White);
	}else if(warning == NO_CUP){
		ssd1306_WriteString("PLACE CUP", Font_11x18, White);
		ssd1306_SetCursor(4, 50);
		ssd1306_WriteString("INSERT CUP TO START", Font_6x8, White);
	}else if(warning == NO_COFFEE){
		ssd1306_WriteString("NO COFFEE", Font_11x18, White);
		ssd1306_SetCursor(4, 50);
		ssd1306_WriteString("LOAD COFFEE PACKETS", Font_6x8, White);
	}
	ssd1306_SetCursor(0, 56);
	ssd1306_WriteString("#", Font_7x10, White);
	ssd1306_UpdateScreen();
	HAL_Delay(1000);
	while(1)
	{
		if(BTN_ENTER_PRESS || BTN_BACK_PRESS) return;
	}
}



