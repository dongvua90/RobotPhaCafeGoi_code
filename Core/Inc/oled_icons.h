#ifndef OLED_ICONS_H
#define OLED_ICONS_H

#include "oled_ssd1306.h"

typedef enum {
    OLED_CAFE_LEVEL_LOW = 0,
    OLED_CAFE_LEVEL_MID,
    OLED_CAFE_LEVEL_HIGH
} OledCafeLevel_t;

#define OLED_ICON_CAFE_LOGO_W 62U
#define OLED_ICON_CAFE_LOGO_H 62U
#define OLED_ICON_CAFE_W 40U
#define OLED_ICON_CAFE_H 27U
#define OLED_ICON_SMOKE_W 18U
#define OLED_ICON_SMOKE_H 12U
#define OLED_ICON_WARNING_W 31U
#define OLED_ICON_WARNING_H 28U

/* 'cafe', 62x62px */
static const uint8_t epd_bitmap_cafe[] = {
    0xff, 0xff, 0xff, 0xff, 0xff, 0xff, 0xff, 0xfc, 0xff, 0xff, 0xff, 0xff, 0xff, 0xff, 0xff, 0xfc,
    0xff, 0xfc, 0x7c, 0x78, 0xff, 0xff, 0xff, 0xfc, 0xff, 0xf8, 0x78, 0x78, 0x7f, 0xff, 0xff, 0xfc,
    0xff, 0xf8, 0x78, 0x70, 0xff, 0xff, 0xff, 0xfc, 0xff, 0xf8, 0xf8, 0xf0, 0xff, 0xff, 0xff, 0xfc,
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    0xff, 0xff, 0xff, 0xff, 0xff, 0xff, 0xff, 0xfc, 0xff, 0xff, 0xff, 0xff, 0xff, 0xff, 0xff, 0xfc
};

/* 'cafe low', 40x27px */
static const uint8_t epd_bitmap_cafe_low[] = {
    0xff, 0xff, 0xff, 0xff, 0xff, 0xe0, 0x00, 0x00, 0x07, 0xff, 0xc0, 0x00, 0x00, 0x03, 0xff, 0xcf,
    0xff, 0xff, 0xfb, 0xff, 0xcf, 0xff, 0xff, 0xfb, 0xff, 0xcf, 0xff, 0xff, 0xf8, 0x0f, 0xcf, 0xff,
    0xff, 0xf8, 0x07, 0xcf, 0xff, 0xff, 0xf8, 0x03, 0xcf, 0xff, 0xff, 0xfb, 0xe3, 0xcf, 0xff, 0xff,
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    0x7f, 0xff, 0xff, 0xc0, 0x01, 0xff, 0xff
};

/* 'cafe mid', 40x27px */
static const uint8_t epd_bitmap_cafe_mid[] = {
    0xff, 0xff, 0xff, 0xff, 0xff, 0xe0, 0x00, 0x00, 0x07, 0xff, 0xc0, 0x00, 0x00, 0x03, 0xff, 0xdf,
    0xff, 0xff, 0xf3, 0xff, 0xdf, 0xff, 0xff, 0xf3, 0xff, 0xdf, 0xff, 0xff, 0xf0, 0x0f, 0xdf, 0xff,
    0xff, 0xf0, 0x07, 0xdf, 0xff, 0xff, 0xf0, 0x07, 0xdf, 0xff, 0xff, 0xf3, 0xe3, 0xdf, 0xff, 0xff,
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    0xff, 0xff, 0xff, 0x80, 0x01, 0xff, 0xff
};

/* 'cafe high', 40x27px */
static const uint8_t epd_bitmap_cafe_high[] = {
    0xff, 0xff, 0xff, 0xff, 0xff, 0xe0, 0x00, 0x00, 0x0f, 0xff, 0xc0, 0x00, 0x00, 0x07, 0xff, 0xdf,
    0xff, 0xff, 0xf7, 0xff, 0xc0, 0x00, 0x00, 0x03, 0xff, 0xc0, 0x00, 0x00, 0x00, 0x1f, 0xc0, 0x00,
    0x00, 0x00, 0x0f, 0xc0, 0x00, 0x00, 0x00, 0x07, 0xc0, 0x00, 0x00, 0x07, 0xc7, 0xc0, 0x00, 0x00,
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    0xff, 0xff, 0xff, 0x80, 0x03, 0xff, 0xff
};

/* 'khoi cafe', 18x12px */
static const uint8_t epd_bitmap_khoi_cafe[] = {
    0xff, 0xff, 0xc0, 0xce, 0x79, 0xc0, 0x8e, 0x71, 0xc0, 0x9c, 0x73, 0xc0, 0x9c, 0x73, 0xc0, 0x8e,
    0x73, 0xc0, 0xc6, 0x31, 0xc0, 0xc7, 0x39, 0xc0, 0xe7, 0x39, 0xc0, 0xc6, 0x39, 0xc0, 0xce, 0x71,
    0xc0, 0xff, 0xff, 0xc0
};

/* 'warning', 31x28px */
static const uint8_t epd_bitmap_warning[] = {
    0xff, 0xff, 0xff, 0xfe, 0xff, 0xfe, 0xff, 0xfe, 0xff, 0xfc, 0x7f, 0xfe, 0xff, 0xf8, 0x3f, 0xfe,
    0xff, 0xf1, 0x1f, 0xfe, 0xff, 0xf3, 0x9f, 0xfe, 0xff, 0xe3, 0x8f, 0xfe, 0xff, 0xe7, 0xcf, 0xfe,
    0xff, 0xc7, 0xc7, 0xfe, 0xff, 0x8c, 0x67, 0xfe, 0xff, 0x9c, 0x73, 0xfe, 0xff, 0x1c, 0x71, 0xfe,
    0xff, 0x3c, 0x79, 0xfe, 0xfe, 0x3c, 0x78, 0xfe, 0xfc, 0x7c, 0x7c, 0xfe, 0xfc, 0xfc, 0x7c, 0x7e,
    0xf8, 0xfc, 0x7e, 0x7e, 0xf9, 0xfc, 0xff, 0x3e, 0xf1, 0xff, 0xff, 0x1e, 0xf3, 0xff, 0xff, 0x9e,
    0xe3, 0xfc, 0xff, 0x8e, 0xc7, 0xfc, 0x7f, 0xce, 0xcf, 0xfe, 0xff, 0xc6, 0x8f, 0xff, 0xff, 0xe2,
    0x80, 0x00, 0x00, 0x02, 0xc0, 0x00, 0x00, 0x06, 0xe0, 0x00, 0x00, 0x0e, 0xff, 0xff, 0xff, 0xfe
};

static inline const uint8_t *OLED_IconGetCafeLevelBitmap(OledCafeLevel_t level)
{
    switch (level) {
    case OLED_CAFE_LEVEL_LOW:
        return epd_bitmap_cafe_low;
    case OLED_CAFE_LEVEL_MID:
        return epd_bitmap_cafe_mid;
    case OLED_CAFE_LEVEL_HIGH:
    default:
        return epd_bitmap_cafe_high;
    }
}

static inline uint8_t OLED_IconMapY(uint8_t yTop, uint8_t iconHeight)
{
    if (iconHeight >= OLED_HEIGHT) {
        return 0U;
    }

    if ((uint16_t)yTop + iconHeight > OLED_HEIGHT) {
        yTop = (uint8_t)(OLED_HEIGHT - iconHeight);
    }

    return (uint8_t)(OLED_HEIGHT - iconHeight - yTop);
}

static inline void OLED_IconDrawCafeState(uint8_t x, uint8_t y, OledCafeLevel_t level, bool showSmoke, bool invert)
{
    uint8_t cupY;
    uint8_t smokeX;
    uint8_t smokeTopY;
    uint8_t smokeY;

    cupY = OLED_IconMapY(y, OLED_ICON_CAFE_H);
    OLED_DrawBitmap(x, cupY, OLED_ICON_CAFE_W, OLED_ICON_CAFE_H, OLED_IconGetCafeLevelBitmap(level), invert);

    if (!showSmoke) {
        return;
    }

    smokeTopY = (y > (OLED_ICON_SMOKE_H + 1U)) ? (uint8_t)(y - OLED_ICON_SMOKE_H - 1U) : 0U;
    smokeX = (uint8_t)(x + ((OLED_ICON_CAFE_W - OLED_ICON_SMOKE_W) / 2U));
    smokeY = OLED_IconMapY(smokeTopY, OLED_ICON_SMOKE_H);
    OLED_DrawBitmap(smokeX, smokeY, OLED_ICON_SMOKE_W, OLED_ICON_SMOKE_H, epd_bitmap_khoi_cafe, invert);
}

static inline void OLED_IconShowCafeState(uint8_t x, uint8_t y, OledCafeLevel_t level, bool showSmoke, bool invert, bool clearBefore, bool updateNow)
{
    if (clearBefore) {
        OLED_Clear();
    }

    OLED_IconDrawCafeState(x, y, level, showSmoke, invert);

    if (updateNow) {
        (void)OLED_Update();
    }
}

static inline void OLED_IconShowCafeLogoCentered(bool invert, bool updateNow)
{
    uint8_t x = (uint8_t)((OLED_WIDTH - OLED_ICON_CAFE_LOGO_W) / 2U);
    uint8_t yTop = (uint8_t)((OLED_HEIGHT - OLED_ICON_CAFE_LOGO_H) / 2U);
    uint8_t y = OLED_IconMapY(yTop, OLED_ICON_CAFE_LOGO_H);

    OLED_Clear();
    OLED_DrawBitmap(x, y, OLED_ICON_CAFE_LOGO_W, OLED_ICON_CAFE_LOGO_H, epd_bitmap_cafe, invert);

    if (updateNow) {
        (void)OLED_Update();
    }
}

#endif
